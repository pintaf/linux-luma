// SPDX-License-Identifier: Apache-2.0
/dts-v1/;
/plugin/;

/* FP5 ABL DT validation: stock board is yupik-idps-amoled with
 * qcom,msm-id = <475 0x10000>, <515 0x10000>; qcom,board-id = <34 2>. */
&{/} {
	qcom,msm-id = <475 0x10000>, <515 0x10000>;
	qcom,board-id = <34 2>;
};
